## rootfs/buildroot/neutron_aarch64_glibc_defconfig
```kconfig
BR2_aarch64=y
BR2_TOOLCHAIN_BUILDROOT=y
BR2_TOOLCHAIN_BUILDROOT_GLIBC=y
BR2_TOOLCHAIN_BUILDROOT_CXX=n
BR2_ROOTFS_DEVICE_CREATION_DYNAMIC_DEVTMPFS=y
BR2_INIT_BUSYBOX=y
BR2_SYSTEM_BIN_SH_BUSYBOX=y
BR2_PACKAGE_BUSYBOX=y
BR2_TARGET_GENERIC_HOSTNAME="neutron"
BR2_TARGET_GENERIC_ISSUE="Neutron minimal AArch64 glibc environment"
BR2_TARGET_GENERIC_REMOUNT_ROOTFS_RW=y
BR2_ROOTFS_POST_BUILD_SCRIPT="/tmp/neutron-post-build.sh"
BR2_TARGET_ROOTFS_TAR=y
BR2_TARGET_ROOTFS_TAR_GZIP=y
BR2_TARGET_ROOTFS_TAR_OPTIONS="--numeric-owner"
```
